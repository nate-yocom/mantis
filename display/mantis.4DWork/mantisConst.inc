// File generated 6/28/2016 12:59:02 AM
// Warning! This is a generated file, any manual changes will be
// lost during the next generation.

#constant  Strings0Count    0
#constant  Strings0Size     1
#constant  Strings1Count    1
#constant  Strings1Size     26
#constant  Strings2Count    1
#constant  Strings2Size     15
#constant  Strings4Count    0
#constant  Strings4Size     1
#constant  Strings5Count    0
#constant  Strings5Size     1
#constant  Strings6Count    0
#constant  Strings6Size     1
#constant  Strings7Count    0
#constant  Strings7Size     1
#constant  Strings8Count    0
#constant  Strings8Size     1
#constant  Strings3Count    1
#constant  Strings3Size     1
#DATA
    byte iKeyboard0keystrokes 0x60, 0x31, 0x32, 0x33, 0x34, 0x35, 0x36, 0x37, 0x38, 0x39, 0x30, 0x2D, 0x3D, 0x08, 0x71, 0x77,
                              0x65, 0x72, 0x74, 0x79, 0x75, 0x69, 0x6F, 0x70, 0x5B, 0x5D, 0x7C, 0xFF, 0x61, 0x73, 0x64, 0x66,
                              0x67, 0x68, 0x6A, 0x6B, 0x6C, 0x3B, 0x2C, 0xFF, 0x7A, 0x78, 0x63, 0x76, 0x62, 0x6E, 0x6D, 0x2C,
                              0x2E, 0x2F, 0xFF, 0x20, 0x7E, 0x21, 0x40, 0x23, 0x24, 0x25, 0x5E, 0x26, 0x2A, 0x28, 0x29, 0x5F,
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                              0x6C, 0x3A, 0x22, 0xFF, 0x7A, 0x78, 0x63, 0x76, 0x62, 0x6E, 0x6D, 0x3C, 0x3E, 0x3F, 0xFF, 0x00
#END


// object indexes into ImageControl
#CONST
    iRotaryswitch0  // offset 0x0
    iLeddigits1     // offset 0x3D800
    iiLeddigits1    // offset 0x41400
    iLeddigits2     // offset 0x4DE00
    iiLeddigits2    // offset 0x51A00
    iLeddigits4     // offset 0x5E400
    iiLeddigits4    // offset 0x62000
    iLeddigits5     // offset 0x6EA00
    iiLeddigits5    // offset 0x72600
    iStatictext1    // offset 0x7F000
    iStatictext2    // offset 0x7FE00
    iStatictext3    // offset 0x80A00
    iStatictext4    // offset 0x81000
    iWinbutton0     // offset 0x81600
    iWinbutton1     // offset 0x85800
    iWinbutton2     // offset 0x87200
    iWinbutton3     // offset 0x88C00
    iWinbutton4     // offset 0x8A600
    iStatictext7    // offset 0x8C000
    iUserled0       // offset 0x8C600
    iStatictext8    // offset 0x8E000
    iStatictext9    // offset 0x8E400
    iUserled1       // offset 0x8E800
    iUserled2       // offset 0x90200
    iStatictext10   // offset 0x91C00
    iStatictext11   // offset 0x92000
    iUserled3       // offset 0x92600
    i4Dbutton1      // offset 0x94000
    iStatictext12   // offset 0x98A00
    iStatictext13   // offset 0x99000
    iUserled4       // offset 0x99400
    i4Dbutton0      // offset 0x9AE00
    iStatictext0    // offset 0x9F800
    iStatictext6    // offset 0x9FC00
    iLeddigits0     // offset 0xA0800
    iiLeddigits0    // offset 0xA4400
    iStatictext5    // offset 0xB0E00
    iUserimages0    // offset 0xB1800
    iWinbutton5     // offset 0xC8A00
    iImage1         // offset 0xD2200
    iKeyboard0      // offset 0xDDE00
    iKeyboard0_0    // offset 0x183C00
    iKeyboard0_1    // offset 0x188400
    iKeyboard0_2    // offset 0x18CC00
    iKeyboard0_3    // offset 0x191400
    iKeyboard0_4    // offset 0x195C00
    iKeyboard0_5    // offset 0x19A400
    iKeyboard0_6    // offset 0x19EC00
    iKeyboard0_7    // offset 0x1A3400
    iKeyboard0_8    // offset 0x1A7C00
    iKeyboard0_9    // offset 0x1AC400
    iKeyboard0_10   // offset 0x1B0C00
    iKeyboard0_11   // offset 0x1B5400
    iKeyboard0_12   // offset 0x1B9C00
    iKeyboard0_13   // offset 0x1BE400
    iKeyboard0_14   // offset 0x1C7200
    iKeyboard0_15   // offset 0x1CBA00
    iKeyboard0_16   // offset 0x1D0200
    iKeyboard0_17   // offset 0x1D4A00
    iKeyboard0_18   // offset 0x1D9200
    iKeyboard0_19   // offset 0x1DDA00
    iKeyboard0_20   // offset 0x1E2200
    iKeyboard0_21   // offset 0x1E6A00
    iKeyboard0_22   // offset 0x1EB200
    iKeyboard0_23   // offset 0x1EFA00
    iKeyboard0_24   // offset 0x1F4200
    iKeyboard0_25   // offset 0x1F8A00
    iKeyboard0_26   // offset 0x1FD200
    iKeyboard0_27   // offset 0x203C00
    iKeyboard0_28   // offset 0x20B800
    iKeyboard0_29   // offset 0x210000
    iKeyboard0_30   // offset 0x214800
    iKeyboard0_31   // offset 0x219000
    iKeyboard0_32   // offset 0x21D800
    iKeyboard0_33   // offset 0x222000
    iKeyboard0_34   // offset 0x226800
    iKeyboard0_35   // offset 0x22B000
    iKeyboard0_36   // offset 0x22F800
    iKeyboard0_37   // offset 0x234000
    iKeyboard0_38   // offset 0x238800
    iKeyboard0_39   // offset 0x23D000
    iKeyboard0_40   // offset 0x245E00
    iKeyboard0_41   // offset 0x24A600
    iKeyboard0_42   // offset 0x24EE00
    iKeyboard0_43   // offset 0x253600
    iKeyboard0_44   // offset 0x257E00
    iKeyboard0_45   // offset 0x25C600
    iKeyboard0_46   // offset 0x260E00
    iKeyboard0_47   // offset 0x265600
    iKeyboard0_48   // offset 0x269E00
    iKeyboard0_49   // offset 0x26E600
    iKeyboard0_50   // offset 0x272E00
    iKeyboard0_51   // offset 0x280000
    iStatictext15   // offset 0x29A400
    iWinbutton6     // offset 0x29BA00
    iWinbutton7     // offset 0x29F200
    iWinbutton8     // offset 0x2A2600
    iStatictext14   // offset 0x2AAE00
#END

#constant  Strings0StartH   0x0
#constant  Strings0StartL   0x0
#constant  Strings1StartH   0x0
#constant  Strings1StartL   0x200
#constant  Strings2StartH   0x0
#constant  Strings2StartL   0x400
#constant  Strings4StartH   0x0
#constant  Strings4StartL   0x600
#constant  Strings5StartH   0x0
#constant  Strings5StartL   0x800
#constant  Strings6StartH   0x0
#constant  Strings6StartL   0xA00
#constant  Strings7StartH   0x0
#constant  Strings7StartL   0xC00
#constant  Strings8StartH   0x0
#constant  Strings8StartL   0xE00
#constant  Strings3StartH   0x0
#constant  Strings3StartL   0x1000
#IFNOT EXISTS NOGLOBALS
var hndl ;
var oKeyboard0[12] := [-1, 0, 0, 0, 0, 40, 51, 255, 255, 28, 52, 1] ;
#ENDIF
